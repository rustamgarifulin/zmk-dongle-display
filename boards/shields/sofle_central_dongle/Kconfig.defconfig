## boards/shields/sofle_central_dongle/Kconfig.defconfig
```kconfig
if SHIELD_SOFLE_CENTRAL_DONGLE

config ZMK_KEYBOARD_NAME
    default "Sofle Dongle"

endif
```

## boards/shields/sofle_central_dongle/Kconfig.shield
```kconfig
config SHIELD_SOFLE_CENTRAL_DONGLE
    def_bool $(shields_list_contains,sofle_central_dongle)
```
